## CMakeLists.txt
```
# SPDX-License-Identifier: Apache-2.0

cmake_minimum_required(VERSION 3.20.0)
find_package(Zephyr REQUIRED HINTS $ENV{ZEPHYR_BASE})
project(syscall_fuzz)

target_sources(app PRIVATE src/main.c)
target_sources_ifdef(CONFIG_SYSCALL_FUZZ_GROUP_POLL app PRIVATE src/group_poll.c)
target_sources_ifdef(CONFIG_SYSCALL_FUZZ_GROUP_OBJECTS app PRIVATE src/group_objects.c)
target_sources_ifdef(CONFIG_SYSCALL_FUZZ_GROUP_FUTEX app PRIVATE src/group_futex.c)
target_sources_ifdef(CONFIG_SYSCALL_FUZZ_GROUP_THREAD app PRIVATE src/group_thread.c)

# Harness code ranges, excluded from AFL coverage (see cov_ranges.py)
set(cov_ranges ${ZEPHYR_BINARY_DIR}/${KERNEL_ELF_NAME}.cov)
add_custom_command(OUTPUT ${cov_ranges}
  COMMAND ${PYTHON_EXECUTABLE} ${CMAKE_CURRENT_SOURCE_DIR}/cov_ranges.py
          ${ZEPHYR_BINARY_DIR}/${KERNEL_ELF_NAME} ${CMAKE_CURRENT_SOURCE_DIR}/src
          ${cov_ranges}
  DEPENDS ${ZEPHYR_BINARY_DIR}/${KERNEL_ELF_NAME} ${CMAKE_CURRENT_SOURCE_DIR}/cov_ranges.py
)
add_custom_target(syscall_fuzz_cov_ranges ALL DEPENDS ${cov_ranges})
add_dependencies(syscall_fuzz_cov_ranges ${logical_target_for_zephyr_elf})
```

## Kconfig
```
# SPDX-License-Identifier: Apache-2.0

choice SYSCALL_FUZZ_GROUP
	prompt "Syscall group to fuzz"
	default SYSCALL_FUZZ_GROUP_POLL
	help
	  Each group interprets the input with its own set of operations;
	  see src/group_*.c. Select a group with groups/<name>.conf, which
	  also enables the kernel features the group needs.

config SYSCALL_FUZZ_GROUP_POLL
	bool "k_poll and the objects it waits on"

config SYSCALL_FUZZ_GROUP_OBJECTS
	bool "Dynamic kernel objects, permissions, thread stacks, events, condvars"

config SYSCALL_FUZZ_GROUP_FUTEX
	bool "Futexes, sys_mutex and the less used k_msgq/k_queue calls"

config SYSCALL_FUZZ_GROUP_THREAD
	bool "Thread attributes: names, deadlines, stack info, custom data"

endchoice

config SYSCALL_FUZZ_WORKERS
	int "User threads interpreting the input"
	default 1 if SYSCALL_FUZZ_GROUP_POLL
	default 2
	range 1 4
	help
	  All workers consume the same input. When one blocks in a syscall the
	  next one runs, so blocking calls can be woken up by later operations.

config SYSCALL_FUZZ_HEAP_SIZE
	int "Resource pool of the workers, in bytes"
	default 16384 if SYSCALL_FUZZ_GROUP_OBJECTS
	default 4096
	help
	  Kernel heap assigned to the workers with k_thread_heap_assign().
	  Dynamic objects, user thread stacks and k_*_alloc_* buffers come from
	  it, so running out of memory is deterministic and does not depend on
	  what the rest of the system allocated.

config SYSCALL_FUZZ_SKIP_KNOWN_BUGS
	bool "Do not feed inputs that trigger already known kernel bugs"
	default y
	help
	  Skips syscalls whose arguments are known to trigger kernel bugs
	  already found by this harness (see known-bugs/ and README.renode),
	  so that long campaigns are not swamped by variants of them:
	  k_thread_create() with a stack too small for TLS/initial frame
	  (kernel writes below the stack object) or larger than the dynamic
	  user stack it runs on (the verifier counts the privileged stack
	  in the object size), k_msgq_alloc_init()
	  with msg_size 0 (assert in put_msg_in_queue()), releasing a dynamic
	  k_msgq/k_stack that was never initialized (k_free() of stale heap
	  contents), user threads deadlocking on k_mutex (assertion from
	  MUTEX_DEADLOCK_DETECT) and dynamic stacks or thread objects freed
	  while a thread runs on them (a never-started thread keeps a
	  reference to those a thread was created on, and such stacks are
	  not passed to k_thread_stack_free()).
	  Disable to reproduce them.

# User threads deadlocking on k_mutex trip an assertion, see above
config MUTEX_DEADLOCK_DETECT
	default n if SYSCALL_FUZZ_SKIP_KNOWN_BUGS

config SYSCALL_FUZZ_SELFTEST
	bool "Harness self-test operations"
	help
	  Adds operations that deliberately trigger a kernel panic (input op
	  byte 0xF0), a kernel-mode CPU fault (0xF1) or a kernel assertion
	  (0xF2), to validate the AFL/Renode crash detection and reporting.
	  Never enable this for real fuzzing campaigns.

source "Kconfig.zephyr"
```

## prj.conf
```kconfig
CONFIG_USERSPACE=y
CONFIG_ASSERT=y
CONFIG_BOOT_BANNER=n
CONFIG_LOG=n

# Fuzzing speed: console output (fault dumps on every user oops) and the
# size-optimized libc dominate run time. Crashes are described by the
# afl_crash record instead; see replay.sh.
CONFIG_SPEED_OPTIMIZATIONS=y
CONFIG_PRINTK=n
CONFIG_EXCEPTION_DEBUG=n
```

## src/main.c
```c
/*
 * SPDX-License-Identifier: Apache-2.0
 *
 * Syscall fuzzing harness for AFL++ + Renode.
 *
 * Renode writes the AFL test case into afl_input (a .noinit buffer) before the
 * CPU starts. The supervisor (main) copies it into a user-accessible partition
 * and starts CONFIG_SYSCALL_FUZZ_WORKERS K_USER threads that interpret it as a
 * sequence of operations, defined by the group selected at build time
 * (group_*.c). All workers consume the same stream: when one blocks in a
 * syscall, the next one carries on, so it can wake the first one up.
 *
 * The harness reports the outcome by calling one of the afl_*() marker
 * functions, which Renode watches for:
 *   afl_done() - the input was consumed (or every worker blocked or died).
 *                User oopses (a syscall rejecting its arguments) and user
 *                faults are expected and only end the offending thread.
 *   afl_bug()  - fatal error in kernel context (CPU fault, panic, assertion)
 *   afl_hang() - a worker stayed runnable without consuming input for HANG_MS
 *
 * Before afl_bug() and afl_hang() the harness fills afl_crash, which the host
 * reads to describe the failure without needing any console output.
 */

#include <string.h>
#include <zephyr/kernel.h>
#include <zephyr/fatal.h>
#include <zephyr/sys/zassert.h>
#if defined(CONFIG_CPU_AARCH32_CORTEX_R)
#include <cmsis_core.h>
#endif

#include "harness.h"

#define AFL_MAGIC     0xAF1F5C11U
struct afl_input {
	uint32_t magic;
	uint32_t len;
	uint8_t data[AFL_INPUT_MAX];
};

/* Written by Renode before boot; not touched by ELF loading or BSS init. */
__noinit struct afl_input afl_input;

#define AFL_CRASH_MAGIC 0xAF1FC4A5U

/* Layout is decoded by afl_syscall.py: keep both in sync. */
struct afl_crash {
	uint32_t magic;
	uint32_t reason;	/* K_ERR_*, or 0xFFFFFFFF for a hang */
	uint32_t thread;	/* k_current_get() */
	uint32_t esf_valid;
	uint32_t r0, r1, r2, r3, r12, lr, pc, xpsr;
	uint32_t dfsr, dfar, ifsr, ifar;
	uint32_t assert_file;	/* const char *, 0 if no assertion failed */
	uint32_t assert_line;
	uint32_t op_offset;	/* input offset of the user thread's current op */
	uint32_t op;		/* raw op byte */
};

__noinit struct afl_crash afl_crash;

/* Marker functions: Renode ends the run when their entry block executes. */
__noinline void afl_done(void)
{
	__asm__ volatile("" ::: "memory");
}

__noinline void afl_bug(unsigned int reason)
{
	ARG_UNUSED(reason);
	__asm__ volatile("" ::: "memory");
}

__noinline void afl_hang(void)
{
	__asm__ volatile("" ::: "memory");
}

K_HEAP_DEFINE(fz_heap, CONFIG_SYSCALL_FUZZ_HEAP_SIZE);

#define USER_STACK_SIZE 2048
K_THREAD_STACK_ARRAY_DEFINE(worker_stacks, NUM_WORKERS, USER_STACK_SIZE);
struct k_thread workers[NUM_WORKERS];

/* Extra thread targets: never started, and already exited */
K_THREAD_STACK_DEFINE(dormant_stack, 1024);
static struct k_thread dormant_thread;
K_THREAD_STACK_DEFINE(dead_stack, 1024);
static struct k_thread dead_thread;
static k_tid_t main_tid;

/*
 * How long a runnable worker may go without consuming input (a hang), the
 * whole run's budget (then the run just ends: long chains of short sleeps
 * are not hangs) and how long all workers may stay blocked.
 */
#define HANG_MS    200
#define RUN_MS     300
#define IDLE_TICKS 4

K_APPMEM_PARTITION_DEFINE(fz_part);
/* Last byte the workers can access (the partition is MPU-aligned) */
extern char z_data_smem_fz_part_part_start[];
extern char z_data_smem_fz_part_part_end[];

/*
 * The workers' view of the input. It is user memory, so syscalls with fuzzed
 * pointers can overwrite it: the stream state comes first, so that copies
 * running off the end of scratch[] or ubuf[] cannot reach it, and the
 * supervisor ends the run if it changes behind the workers' back (raw
 * pointers can still hit it).
 */
K_APP_BMEM(fz_part) struct fz_mem fz_mem;
static uint32_t klen;	/* kernel copy of fz_mem.ulen */

static struct k_mem_domain fz_domain;

/*
 * Takes the next input byte's position. Atomic: a worker preempted between
 * reading and writing upos would otherwise write back an old position after
 * the other worker consumed bytes, i.e. rewind the stream (and the
 * supervisor then ends the run).
 */
BUILD_ASSERT(sizeof(atomic_t) == sizeof(fz_mem.upos));

static bool take(uint32_t *pos)
{
	atomic_val_t p;

	do {
		p = atomic_get((atomic_t *)&fz_mem.upos);
		if ((uint32_t)p >= fz_mem.ulen || (uint32_t)p >= AFL_INPUT_MAX) {
			return false;
		}
	} while (!atomic_cas((atomic_t *)&fz_mem.upos, p, p + 1));
	*pos = (uint32_t)p;
	return true;
}

uint8_t next_u8(void)
{
	uint32_t pos;

	return take(&pos) ? fz_mem.ubuf[pos] : 0;
}

uint32_t next_u32(void)
{
	uint32_t v = 0;

	for (int i = 0; i < 4; i++) {
		v |= (uint32_t)next_u8() << (8 * i);
	}
	return v;
}

/*
 * A raw address from the input, except below the input buffer in the
 * workers' partition: syscalls (or user code, e.g. sys_mutex on a raw
 * pointer) writing into the stream state at the start of fz_mem rewind the
 * stream, and the input then replays in a loop until the run budget is
 * exhausted. Group data may precede fz_mem, so a write starting there can
 * reach it too. Memory below the partition is not writable by the workers.
 */
void *fz_raw_ptr(void)
{
	uintptr_t v = next_u32();

	if (v >= (uintptr_t)z_data_smem_fz_part_part_start && v < (uintptr_t)fz_mem.ubuf) {
		return &scratch[0];
	}
	return (void *)v;
}

void *fz_ptr(void)
{
	uint8_t sel = next_u8();

	switch (sel % 8) {
	case 0:
		return &scratch[next_u8() % SCRATCH_SIZE];
	case 1:
		return NULL;
	case 2:
		return &afl_crash;		/* kernel data */
	case 3:
		return fz_raw_ptr();
	case 4:
		return &scratch[SCRATCH_SIZE - 1 - next_u8() % 8];	/* runs off scratch */
	case 5:
		/* partition end */
		return (void *)((uintptr_t)z_data_smem_fz_part_part_end - 1 - next_u8() % 8);
	case 6:
		return (void *)&fz_ptr;		/* code */
	default:
		return &scratch[0];
	}
}

size_t fz_len(void)
{
	uint8_t sel = next_u8();

	switch (sel % 4) {
	case 0:
		return next_u8();
	case 1:
		return next_u32();
	case 2:
		return SIZE_MAX - next_u8();
	default:
		return sel >> 2;
	}
}

k_timeout_t fz_timeout(void)
{
	uint8_t sel = next_u8();

	switch (sel % 4) {
	case 0:
		return K_NO_WAIT;
	case 1:
		return K_TICKS(1 + (sel >> 2) % 3);
	case 2:
		return K_FOREVER;
	default:
		/* Raw: huge, negative and (with TIMEOUT_64BIT) absolute timeouts */
		return (k_timeout_t){ .ticks = (k_ticks_t)(int32_t)next_u32() };
	}
}

struct k_thread *fz_thread(void)
{
	uint8_t sel = next_u8();

	switch (sel % 8) {
	case 0:
		return k_current_get();
	case 1:
	case 2:
		return &workers[(sel % 8 - 1) % NUM_WORKERS];
	case 3:
		return &dormant_thread;
	case 4:
		return &dead_thread;
	case 5:
		return main_tid;		/* no permission */
	case 6:
		return NULL;
	default:
		return (struct k_thread *)fz_raw_ptr();
	}
}

void fz_child_entry(void *p1, void *p2, void *p3)
{
	ARG_UNUSED(p2);
	ARG_UNUSED(p3);

	k_sleep(K_TICKS((uintptr_t)p1 % 4));
}

static void dead_entry(void *p1, void *p2, void *p3)
{
	ARG_UNUSED(p1);
	ARG_UNUSED(p2);
	ARG_UNUSED(p3);
}

/* Raw op bytes (checked before the group sees them) for CONFIG_SYSCALL_FUZZ_SELFTEST */
#define OP_SELFTEST_PANIC 0xF0
#define OP_SELFTEST_FAULT 0xF1
#define OP_SELFTEST_ASSERT 0xF2

/* Worker entry. Coverage (AFL_RENODE_COVERAGE=window) starts here. */
static void user_entry(void *p1, void *p2, void *p3)
{
	ARG_UNUSED(p1);
	ARG_UNUSED(p2);
	ARG_UNUSED(p3);

	uint32_t pos;

	while (take(&pos)) {
		uint8_t op = fz_mem.ubuf[pos];

		fz_mem.op_offset = pos;
		fz_mem.cur_op = op;

		if (IS_ENABLED(CONFIG_SYSCALL_FUZZ_SELFTEST) &&
		    (op == OP_SELFTEST_PANIC || op == OP_SELFTEST_FAULT ||
		     op == OP_SELFTEST_ASSERT)) {
			fz_mem.selftest_op = op;
			fz_mem.upos = fz_mem.ulen;
			return;
		}

		group_op(op);
	}
}

static void record_crash(unsigned int reason, const struct arch_esf *esf)
{
	afl_crash.reason = reason;
	afl_crash.thread = (uint32_t)(uintptr_t)k_current_get();
	if (esf != NULL) {
		afl_crash.esf_valid = 1;
		afl_crash.r0 = esf->basic.r0;
		afl_crash.r1 = esf->basic.r1;
		afl_crash.r2 = esf->basic.r2;
		afl_crash.r3 = esf->basic.r3;
		afl_crash.r12 = esf->basic.r12;
		afl_crash.lr = esf->basic.lr;
		afl_crash.pc = esf->basic.pc;
		afl_crash.xpsr = esf->basic.xpsr;
	}
#if defined(CONFIG_CPU_AARCH32_CORTEX_R)
	afl_crash.dfsr = __get_DFSR();
	afl_crash.dfar = __get_DFAR();
	afl_crash.ifsr = __get_IFSR();
	afl_crash.ifar = __get_IFAR();
#endif
	afl_crash.op_offset = fz_mem.op_offset;
	afl_crash.op = fz_mem.cur_op;
	afl_crash.magic = AFL_CRASH_MAGIC;
}

/* Same as the default, but keeps the location for the crash record */
void zassert_post_action(const char *file, unsigned int line)
{
	afl_crash.assert_file = (uint32_t)(uintptr_t)file;
	afl_crash.assert_line = line;

	if (k_is_user_context()) {
		k_oops();
	}
	k_panic();
	CODE_UNREACHABLE;
}

void k_sys_fatal_error_handler(unsigned int reason, const struct arch_esf *esf)
{
	bool user_fault = esf != NULL && (esf->basic.xpsr & MODE_MASK) == MODE_USR;

	/*
	 * A syscall rejecting its arguments oopses the calling user thread, and a
	 * fault in user mode is the user thread's own problem. Both are expected;
	 * returning lets the kernel abort the thread and the supervisor carry on.
	 */
	if ((k_current_get()->base.user_options & K_USER) != 0 &&
	    (reason == K_ERR_KERNEL_OOPS || user_fault)) {
		/* A user-context assertion is not a kernel bug either */
		afl_crash.assert_file = 0;
		return;
	}

	record_crash(reason, esf);
	afl_bug(reason);
	(void)arch_irq_lock();
	for (;;) {
	}
}

static void hang(void)
{
	record_crash(0xFFFFFFFFU, NULL);
	afl_hang();
	for (;;) {
		k_sleep(K_FOREVER);
	}
}

/*
 * Waits until the input is consumed and no worker can run any more (all are
 * dead, pending or suspended). Workers blocked forever, or deadlocked on each
 * other, are a user-level outcome, not a kernel bug: if no worker can run for
 * IDLE_TICKS consecutive ticks the run is over. A worker that stays runnable
 * for HANG_MS without the input advancing is a hang (e.g. a kernel livelock).
 * After RUN_MS the run ends anyway: input still being consumed (e.g. many
 * short sleeps) is progress, not a hang. The supervisor has a higher priority
 * than any user thread (users cannot raise theirs above their own), so it
 * gets to run every tick.
 */
static void supervise(void)
{
	const uint8_t blocked = _THREAD_PENDING | _THREAD_SLEEPING | _THREAD_SUSPENDED |
				_THREAD_DEAD;
	int64_t start = k_uptime_get();
	int64_t deadline = start + HANG_MS;
	int idle = 0;

	uint32_t last_pos = 0;

	for (;;) {
		bool alive = false, runnable = false;

		/*
		 * A syscall wrote over the stream state (through a raw pointer):
		 * the input would be replayed or overrun, so the run is over. This
		 * is deterministic, so AFL just sees a shorter run.
		 */
		if (fz_mem.ulen != klen || fz_mem.upos < last_pos || fz_mem.upos > klen) {
			return;
		}
		if (fz_mem.upos != last_pos) {
			deadline = k_uptime_get() + HANG_MS;
		}
		last_pos = fz_mem.upos;
		if (k_uptime_get() > start + RUN_MS) {
			return;
		}

		for (int i = 0; i < NUM_WORKERS; i++) {
			uint8_t state = workers[i].base.thread_state;

			alive |= (state & _THREAD_DEAD) == 0;
			runnable |= (state & blocked) == 0;
		}
		if (!alive) {
			return;
		}
		if (runnable) {
			idle = 0;
			if (k_uptime_get() > deadline) {
				hang();
			}
		} else if (fz_mem.upos >= fz_mem.ulen || ++idle > IDLE_TICKS) {
			return;
		}
		k_sleep(K_TICKS(1));
	}
}

int main(void)
{
	struct k_mem_partition *parts[] = { &fz_part };

	memset(&afl_crash, 0, sizeof(afl_crash));

	if (afl_input.magic != AFL_MAGIC || afl_input.len > AFL_INPUT_MAX) {
		printk("syscall-fuzz: no valid input\n");
		afl_done();
		return 0;
	}

	memcpy(fz_mem.ubuf, afl_input.data, afl_input.len);
	fz_mem.ulen = afl_input.len;
	fz_mem.upos = 0;
	klen = afl_input.len;
	main_tid = k_current_get();

	k_mem_domain_init(&fz_domain, ARRAY_SIZE(parts), parts);

	k_thread_create(&dead_thread, dead_stack, K_THREAD_STACK_SIZEOF(dead_stack),
			dead_entry, NULL, NULL, NULL, K_PRIO_PREEMPT(1), K_USER, K_FOREVER);
	k_mem_domain_add_thread(&fz_domain, &dead_thread);
	k_thread_start(&dead_thread);
	k_thread_join(&dead_thread, K_FOREVER);

	k_thread_create(&dormant_thread, dormant_stack, K_THREAD_STACK_SIZEOF(dormant_stack),
			fz_child_entry, NULL, NULL, NULL, K_PRIO_PREEMPT(2), K_USER, K_FOREVER);
	k_mem_domain_add_thread(&fz_domain, &dormant_thread);

	for (int i = 0; i < NUM_WORKERS; i++) {
		k_thread_create(&workers[i], worker_stacks[i], USER_STACK_SIZE, user_entry,
				NULL, NULL, NULL, K_PRIO_PREEMPT(1), K_USER, K_FOREVER);
		k_mem_domain_add_thread(&fz_domain, &workers[i]);
		k_thread_heap_assign(&workers[i], &fz_heap);
	}
	for (int i = 0; i < NUM_WORKERS; i++) {
		for (int j = 0; j < NUM_WORKERS; j++) {
			k_object_access_grant(&workers[j], &workers[i]);
		}
		k_object_access_grant(&dormant_thread, &workers[i]);
		k_object_access_grant(&dead_thread, &workers[i]);
	}
	group_setup();

	for (int i = 0; i < NUM_WORKERS; i++) {
		k_thread_start(&workers[i]);
	}
	supervise();

	if (IS_ENABLED(CONFIG_SYSCALL_FUZZ_SELFTEST)) {
		if (fz_mem.selftest_op == OP_SELFTEST_PANIC) {
			k_panic();
		} else if (fz_mem.selftest_op == OP_SELFTEST_FAULT) {
			/* Kernel-mode access to unmapped memory */
			(void)*(volatile uint32_t *)0xF0000000;
		}
		__ASSERT(fz_mem.selftest_op != OP_SELFTEST_ASSERT, "selftest assertion");
	}

	afl_done();

	return 0;
}
```

## src/group_futex.c
```c
/*
 * SPDX-License-Identifier: Apache-2.0
 *
 * Group "futex": k_futex_wait/wake, sys_mutex (which, with
 * CONFIG_SYS_MUTEX_IMPL_FUTEX, is built on futexes in user memory and with
 * CONFIG_SYS_MUTEX_IMPL_K_MUTEX on z_sys_mutex_kernel_lock/unlock), and the
 * less used k_msgq/k_queue calls (peek_at, put_front, get_attrs,
 * cancel_wait, ...).
 *
 * Futex words live in user memory, so workers may also overwrite them
 * directly (OP_FUTEX_STORE), including the words behind a sys_mutex that
 * another worker holds or waits on: the kernel must not trust them.
 */

#include <zephyr/sys/mutex.h>
#include "harness.h"

K_APP_DMEM(fz_part) static struct k_futex futexes[2];
K_APP_DMEM(fz_part) static SYS_MUTEX_DEFINE(mutex0);
K_APP_DMEM(fz_part) static SYS_MUTEX_DEFINE(mutex1);

K_MSGQ_DEFINE(msgq4, 4, 4, 4);
K_MSGQ_DEFINE(msgq7, 7, 3, 1);	/* odd size: index and wrap-around arithmetic */
K_MSGQ_DEFINE(ungranted_msgq, 4, 2, 4);
K_QUEUE_DEFINE(queue);
K_QUEUE_DEFINE(ungranted_queue);
K_SEM_DEFINE(sem, 0, 1);	/* wrong type for the msgq/queue calls */

K_APP_BMEM(fz_part) static struct k_msgq_attrs attrs;
K_APP_BMEM(fz_part) static uint32_t result;

static struct k_futex *futex(void)
{
	uint8_t sel = next_u8();

	switch (sel % 8) {
	case 0:
	case 1:
		return &futexes[sel % 2];
#if defined(CONFIG_SYS_MUTEX_IMPL_FUTEX)
	case 2:
		return &mutex0.futex;
	case 3:
		return &mutex1.futex;
#endif
	case 4:
		return (struct k_futex *)&scratch[next_u8() % (SCRATCH_SIZE - 3)];
	case 5:
		return (struct k_futex *)&sem;	/* kernel memory */
	case 6:
		return NULL;
	default:
		return (struct k_futex *)fz_raw_ptr();
	}
}

static struct sys_mutex *mutex(void)
{
	uint8_t sel = next_u8();

	switch (sel % 6) {
	case 0:
		return &mutex0;
	case 1:
		return &mutex1;
	case 2:
		return (struct sys_mutex *)&futexes[0];	/* user memory, not a sys_mutex */
	case 3:
		return (struct sys_mutex *)&sem;
	case 4:
		return NULL;
	default:
		return (struct sys_mutex *)fz_raw_ptr();
	}
}

static struct k_msgq *msgq(void)
{
	uint8_t sel = next_u8();

	switch (sel % 6) {
	case 0:
		return &msgq4;
	case 1:
		return &msgq7;
	case 2:
		return &ungranted_msgq;
	case 3:
		return (struct k_msgq *)&sem;
	case 4:
		return NULL;
	default:
		return (struct k_msgq *)fz_raw_ptr();
	}
}

static struct k_queue *queue_sel(void)
{
	uint8_t sel = next_u8();

	switch (sel % 5) {
	case 0:
		return &queue;
	case 1:
		return &ungranted_queue;
	case 2:
		return (struct k_queue *)&sem;
	case 3:
		return NULL;
	default:
		return (struct k_queue *)fz_raw_ptr();
	}
}

static bool in_user_mem(const void *p)
{
	uintptr_t a = (uintptr_t)p;

	return (a >= (uintptr_t)&scratch[0] && a < (uintptr_t)&scratch[SCRATCH_SIZE]) ||
	       (a >= (uintptr_t)&futexes[0] && a < (uintptr_t)&futexes[2]) ||
	       p == (void *)&mutex0 || p == (void *)&mutex1;
}

enum op {
	OP_FUTEX_WAIT,
	OP_FUTEX_WAKE,
	OP_FUTEX_STORE,
	OP_MUTEX_LOCK,
	OP_MUTEX_UNLOCK,
	OP_MUTEX_INIT,
	OP_MSGQ_PUT,
	OP_MSGQ_GET,
	OP_MSGQ_PUT_FRONT,
	OP_MSGQ_PEEK,
	OP_MSGQ_PEEK_AT,
	OP_MSGQ_ATTRS,
	OP_MSGQ_PURGE,
	OP_QUEUE_INSERT,
	OP_QUEUE_GET,
	OP_QUEUE_PEEK,
	OP_QUEUE_CANCEL_WAIT,
	OP_SLEEP,
	OP_COUNT,
};

void group_setup(void)
{
	for (int i = 0; i < NUM_WORKERS; i++) {
		k_thread_access_grant(&workers[i], &msgq4, &msgq7, &queue, &sem);
	}
}

void group_op(uint8_t op)
{
	switch (op % OP_COUNT) {
	case OP_FUTEX_WAIT: {
		struct k_futex *f = futex();
		uint8_t sel = next_u8();
		/* Usually the current value (when readable), so the wait blocks */
		atomic_val_t expected = (sel & 1) ? (atomic_val_t)next_u32()
				      : in_user_mem(f) ? atomic_get(&f->val) : 0;

		result = k_futex_wait(f, expected, fz_timeout());
		break;
	}
	case OP_FUTEX_WAKE: {
		struct k_futex *f = futex();

		result = k_futex_wake(f, next_u8() & 1);
		break;
	}
	case OP_FUTEX_STORE: {
		uint8_t sel = next_u8() % 4;
		atomic_t *word = sel < 2 ? &futexes[sel].val
#if defined(CONFIG_SYS_MUTEX_IMPL_FUTEX)
				 : &(sel == 2 ? &mutex0 : &mutex1)->futex.val;
#else
				 : &(sel == 2 ? &mutex0 : &mutex1)->val;
#endif

		atomic_set(word, (atomic_val_t)next_u32());
		break;
	}
	case OP_MUTEX_LOCK: {
		struct sys_mutex *m = mutex();

		result = sys_mutex_lock(m, fz_timeout());
		break;
	}
	case OP_MUTEX_UNLOCK:
		result = sys_mutex_unlock(mutex());
		break;
	case OP_MUTEX_INIT:
		sys_mutex_init(mutex());
		break;
	case OP_MSGQ_PUT: {
		struct k_msgq *q = msgq();
		void *data = fz_ptr();

		result = k_msgq_put(q, data, fz_timeout());
		break;
	}
	case OP_MSGQ_GET: {
		struct k_msgq *q = msgq();
		void *data = fz_ptr();

		result = k_msgq_get(q, data, fz_timeout());
		break;
	}
	case OP_MSGQ_PUT_FRONT: {
		struct k_msgq *q = msgq();

		result = k_msgq_put_front(q, fz_ptr());
		break;
	}
	case OP_MSGQ_PEEK: {
		struct k_msgq *q = msgq();

		result = k_msgq_peek(q, fz_ptr());
		break;
	}
	case OP_MSGQ_PEEK_AT: {
		struct k_msgq *q = msgq();
		void *data = fz_ptr();

		result = k_msgq_peek_at(q, data, next_u32());
		break;
	}
	case OP_MSGQ_ATTRS: {
		struct k_msgq *q = msgq();
		uint8_t sel = next_u8();

		if (sel % 3 == 0) {
			k_msgq_get_attrs(q, (sel & 4) ? fz_ptr() : &attrs);
		} else if (sel % 3 == 1) {
			result = k_msgq_num_free_get(q);
		} else {
			result = k_msgq_num_used_get(q);
		}
		break;
	}
	case OP_MSGQ_PURGE:
		k_msgq_purge(msgq());
		break;
	case OP_QUEUE_INSERT: {
		struct k_queue *q = queue_sel();
		uint8_t sel = next_u8();
		void *data = fz_ptr();

		result = (sel & 1) ? k_queue_alloc_prepend(q, data) : k_queue_alloc_append(q, data);
		break;
	}
	case OP_QUEUE_GET: {
		struct k_queue *q = queue_sel();

		result = (uintptr_t)k_queue_get(q, fz_timeout());
		break;
	}
	case OP_QUEUE_PEEK: {
		struct k_queue *q = queue_sel();
		uint8_t sel = next_u8();

		result = sel % 3 == 0 ? (uintptr_t)k_queue_peek_head(q)
			 : sel % 3 == 1 ? (uintptr_t)k_queue_peek_tail(q) : k_queue_is_empty(q);
		break;
	}
	case OP_QUEUE_CANCEL_WAIT:
		k_queue_cancel_wait(queue_sel());
		break;
	case OP_SLEEP:
		(void)k_sleep(fz_timeout());
		break;
	default:
		break;
	}
}
```

## src/group_objects.c
```c
/*
 * SPDX-License-Identifier: Apache-2.0
 *
 * Group "objects": the lifecycle of dynamic kernel objects and the calls that
 * use them. Workers allocate objects (k_object_alloc/_size), initialise them as
 * any type, grant them to other threads, release them, and use them while
 * other workers may be blocked on them. Thread stacks are allocated and freed
 * (k_thread_stack_alloc/free) and used to create short-lived user threads, so
 * stacks can be freed while their thread is still running or after it exited.
 *
 * Objects are referred to by selector (see obj()), so a slot keeps whatever a
 * syscall returned, including NULL, and ops can apply to stale pointers after
 * a release.
 */

#include "harness.h"

#define NUM_SLOTS  8
#define NUM_STACKS 4

/* Statically allocated objects, granted to the workers */
K_SEM_DEFINE(st_sem, 0, 4);
K_EVENT_DEFINE(st_event);
K_CONDVAR_DEFINE(st_condvar);
K_MUTEX_DEFINE(st_mutex);
/* Never granted */
K_SEM_DEFINE(ungranted_sem, 0, 1);

K_APP_BMEM(fz_part) static void *slot[NUM_SLOTS];
K_APP_BMEM(fz_part) static k_thread_stack_t *stk[NUM_STACKS];
/* Requested sizes of the dynamic stacks in slot[] and stk[] (SKIP_KNOWN_BUGS) */
K_APP_BMEM(fz_part) static size_t slot_stack_size[NUM_SLOTS];
K_APP_BMEM(fz_part) static size_t stk_size[NUM_STACKS];
K_APP_BMEM(fz_part) static uint32_t evset;
/*
 * SKIP_KNOWN_BUGS: dynamic stacks a thread was created on, which must not be
 * freed while it may run, and a never-started thread that keeps a reference
 * to them (see do_thread_create()).
 */
#define MAX_BUSY (NUM_SLOTS + NUM_STACKS)
K_APP_BMEM(fz_part) static const void *busy[MAX_BUSY];
static struct k_thread keeper;
static K_THREAD_STACK_DEFINE(keeper_stack, 256);

static const enum k_objects types[] = {
	K_OBJ_SEM, K_OBJ_EVENT, K_OBJ_CONDVAR, K_OBJ_MUTEX, K_OBJ_MSGQ,
	K_OBJ_STACK, K_OBJ_QUEUE, K_OBJ_PIPE, K_OBJ_THREAD,
	K_OBJ_THREAD_STACK_ELEMENT, K_OBJ_POLL_SIGNAL, K_OBJ_TIMER,
	K_OBJ_SYS_MUTEX, K_OBJ_ANY,
};

static enum k_objects otype(void)
{
	uint8_t sel = next_u8();

	return sel < ARRAY_SIZE(types) ? types[sel] : (enum k_objects)(sel - ARRAY_SIZE(types));
}

/*
 * Known bug: unref_check() runs z_msgq_cleanup()/z_stack_cleanup() on
 * dynamic objects that were never initialized; k_object_alloc() does not
 * zero them, so stale heap contents get k_free()d. Initialize such objects
 * right away (consumes no input) so they are always valid when released.
 */
static void *alloced(void *o, enum k_objects t)
{
	if (!IS_ENABLED(CONFIG_SYSCALL_FUZZ_SKIP_KNOWN_BUGS) || o == NULL) {
		return o;
	}
	if (t == K_OBJ_MSGQ) {
		(void)k_msgq_alloc_init(o, 4, 1);
	} else if (t == K_OBJ_STACK) {
		(void)k_stack_alloc_init(o, 1);
	}
	return o;
}

static void *obj(void)
{
	uint8_t sel = next_u8() % (NUM_SLOTS + 9);

	if (sel < NUM_SLOTS) {
		return slot[sel];
	}
	switch (sel - NUM_SLOTS) {
	case 0:
		return &st_sem;
	case 1:
		return &st_event;
	case 2:
		return &st_condvar;
	case 3:
		return &st_mutex;
	case 4:
		return &ungranted_sem;
	case 5:
		return stk[next_u8() % NUM_STACKS];
	case 6:
		return fz_thread();
	case 7:
		return NULL;
	default:
		return fz_raw_ptr();
	}
}

static bool is_dynamic(const void *o)
{
	for (int i = 0; i < NUM_SLOTS; i++) {
		if (o != NULL && o == slot[i]) {
			return true;
		}
	}
	for (int i = 0; i < NUM_STACKS; i++) {
		if (o != NULL && (const void *)o == stk[i]) {
			return true;
		}
	}
	return false;
}

static bool is_busy(const void *o)
{
	for (int i = 0; i < MAX_BUSY; i++) {
		if (o != NULL && busy[i] == o) {
			return true;
		}
	}
	return false;
}

static void set_busy(const void *o)
{
	if (!is_dynamic(o) || is_busy(o)) {
		return;
	}
	for (int i = 0; i < MAX_BUSY; i++) {
		if (busy[i] == NULL) {
			busy[i] = o;
			return;
		}
	}
}

static k_thread_stack_t *stack(void)
{
	uint8_t sel = next_u8();

	return sel < 0xF0 ? stk[sel % NUM_STACKS] : obj();
}

enum op {
	OP_ALLOC,
	OP_ALLOC_SIZE,
	OP_RELEASE,
	OP_GRANT,
	OP_ACCESS_CHECK,
	OP_INIT,
	OP_SEM,
	OP_EVENT_SET,
	OP_EVENT_WAIT,
	OP_CONDVAR_SIGNAL,
	OP_CONDVAR_WAIT,
	OP_MUTEX,
	OP_USE,
	OP_STACK_ALLOC,
	OP_STACK_FREE,
	OP_THREAD_CREATE,
	OP_THREAD_JOIN,
	OP_SLEEP,
	OP_COUNT,
};

static void do_init(void)
{
	void *o = obj();

	switch (next_u8() % 9) {
	case 0: {
		uint32_t initial = next_u8(), limit = next_u8();

		(void)k_sem_init(o, initial, limit);
		break;
	}
	case 1:
		k_event_init(o);
		break;
	case 2:
		(void)k_condvar_init(o);
		break;
	case 3:
		(void)k_mutex_init(o);
		break;
	case 4: {
		size_t msg_size = fz_len();
		uint32_t max_msgs = next_u32();

		if (IS_ENABLED(CONFIG_SYSCALL_FUZZ_SKIP_KNOWN_BUGS) && msg_size == 0) {
			break;
		}
		(void)k_msgq_alloc_init(o, msg_size, max_msgs);
		break;
	}
	case 5:
		(void)k_stack_alloc_init(o, next_u32());
		break;
	case 6:
		k_queue_init(o);
		break;
	case 7: {
		uint8_t *buf = fz_ptr();

		k_pipe_init(o, buf, fz_len());
		break;
	}
	default:
		k_poll_signal_init(o);
		break;
	}
}

/* Data path of the other object types, on whatever obj() returns */
static void do_use(void)
{
	void *o = obj();
	uint8_t kind = next_u8();

	switch (kind % 8) {
	case 0: {
		void *data = fz_ptr();

		(void)k_msgq_put(o, data, fz_timeout());
		break;
	}
	case 1: {
		void *data = fz_ptr();

		(void)k_msgq_get(o, data, fz_timeout());
		break;
	}
	case 2:
		(void)k_stack_push(o, next_u32());
		break;
	case 3: {
		stack_data_t *data = fz_ptr();

		(void)k_stack_pop(o, data, fz_timeout());
		break;
	}
	case 4:
		(void)k_queue_alloc_append(o, fz_ptr());
		break;
	case 5:
		(void)k_queue_get(o, fz_timeout());
		break;
	case 6: {
		void *data = fz_ptr();

		(void)k_pipe_write(o, data, fz_len(), fz_timeout());
		break;
	}
	default: {
		void *data = fz_ptr();

		(void)k_pipe_read(o, data, fz_len(), fz_timeout());
		break;
	}
	}
}

static void do_event_wait(void)
{
	void *o = obj();
	uint8_t kind = next_u8();
	uint32_t events = next_u32();
	bool reset = kind & BIT(2);
	k_timeout_t timeout = fz_timeout();

	switch (kind % 4) {
	case 0:
		evset = k_event_wait(o, events, reset, timeout);
		break;
	case 1:
		evset = k_event_wait_all(o, events, reset, timeout);
		break;
	case 2:
		evset = k_event_wait_safe(o, events, reset, timeout);
		break;
	default:
		evset = k_event_wait_all_safe(o, events, reset, timeout);
		break;
	}
}

static void do_event_set(void)
{
	void *o = obj();
	uint8_t kind = next_u8();
	uint32_t events = next_u32();

	switch (kind % 4) {
	case 0:
		evset = k_event_post(o, events);
		break;
	case 1:
		evset = k_event_set(o, events);
		break;
	case 2:
		evset = k_event_set_masked(o, events, next_u32());
		break;
	default:
		evset = k_event_clear(o, events);
		break;
	}
}

/*
 * Known bug: the kernel does not check that TLS + initial frame fit in the
 * user-supplied stack size and writes below the stack object.
 */
#define KNOWN_BUG_MIN_STACK 128

/*
 * Known bug: for a dynamically allocated user stack (k_thread_stack_alloc()
 * with K_USER, or k_object_alloc_size(K_OBJ_THREAD_STACK_ELEMENT)) the
 * object's size is the whole allocation, privileged stack included, so
 * k_thread_create() accepts a stack_size larger than the one requested and
 * the user stack region covers the privileged stack. Returns the size
 * requested for s if it is one of ours, else SIZE_MAX.
 */
static size_t dyn_stack_size(const void *s)
{
	for (int i = 0; i < NUM_STACKS; i++) {
		if (s != NULL && s == stk[i]) {
			return stk_size[i];
		}
	}
	for (int i = 0; i < NUM_SLOTS; i++) {
		if (s != NULL && s == slot[i]) {
			return slot_stack_size[i];
		}
	}
	return SIZE_MAX;
}

static void do_thread_create(void)
{
	struct k_thread *t = obj();
	k_thread_stack_t *s = stack();
	size_t size = fz_len();
	uint8_t prio = next_u8();
	uint32_t options = next_u8() | K_USER;
	uintptr_t ticks = next_u8();
	k_timeout_t delay = fz_timeout();

	if (IS_ENABLED(CONFIG_SYSCALL_FUZZ_SKIP_KNOWN_BUGS) &&
	    (size < KNOWN_BUG_MIN_STACK || size > dyn_stack_size(s))) {
		return;
	}
	if (IS_ENABLED(CONFIG_SYSCALL_FUZZ_SKIP_KNOWN_BUGS)) {
		/* Before the call: the new thread may run at once */
		set_busy(s);
	}
	k_tid_t tid = k_thread_create(t, s, size, fz_child_entry, (void *)ticks, NULL, NULL,
				      K_PRIO_PREEMPT(1 + prio % 8), options, delay);

	/*
	 * Known bug: a dynamic stack or thread object is freed when the last
	 * thread with permission on it drops it (k_object_release(), exit,
	 * or an oops killing a worker) while a thread still runs on it. The
	 * create succeeded, so the caller has permission on both: the keeper
	 * holds one for good. It cannot be done before: the grant oopses
	 * where the create may just fail.
	 */
	if (IS_ENABLED(CONFIG_SYSCALL_FUZZ_SKIP_KNOWN_BUGS) && tid != NULL) {
		if (is_dynamic(s)) {
			k_object_access_grant(s, &keeper);
		}
		if (is_dynamic(t)) {
			k_object_access_grant(t, &keeper);
		}
	}
}

void group_setup(void)
{
	if (IS_ENABLED(CONFIG_SYSCALL_FUZZ_SKIP_KNOWN_BUGS)) {
		k_thread_create(&keeper, keeper_stack, K_THREAD_STACK_SIZEOF(keeper_stack),
				fz_child_entry, NULL, NULL, NULL, K_PRIO_PREEMPT(2), K_USER,
				K_FOREVER);
		for (int i = 0; i < NUM_WORKERS; i++) {
			k_object_access_grant(&keeper, &workers[i]);
		}
	}
	for (int i = 0; i < NUM_WORKERS; i++) {
		k_thread_access_grant(&workers[i], &st_sem, &st_event, &st_condvar, &st_mutex);
	}
}

void group_op(uint8_t op)
{
	switch (op % OP_COUNT) {
	case OP_ALLOC: {
		uint8_t i = next_u8() % NUM_SLOTS;

		enum k_objects t = otype();

		slot[i] = alloced(k_object_alloc(t), t);
		slot_stack_size[i] = SIZE_MAX;
		break;
	}
	case OP_ALLOC_SIZE: {
		uint8_t i = next_u8() % NUM_SLOTS;
		enum k_objects t = otype();
		size_t size = fz_len();

		slot[i] = alloced(k_object_alloc_size(t, size), t);
		slot_stack_size[i] = t == K_OBJ_THREAD_STACK_ELEMENT ? size : SIZE_MAX;
		break;
	}
	case OP_RELEASE:
		k_object_release(obj());
		break;
	case OP_GRANT: {
		void *o = obj();

		k_object_access_grant(o, fz_thread());
		break;
	}
	case OP_ACCESS_CHECK:
		(void)k_object_access_check(obj());
		break;
	case OP_INIT:
		do_init();
		break;
	case OP_SEM: {
		void *o = obj();

		if (next_u8() & 1) {
			k_sem_give(o);
		} else {
			(void)k_sem_take(o, fz_timeout());
		}
		break;
	}
	case OP_EVENT_SET:
		do_event_set();
		break;
	case OP_EVENT_WAIT:
		do_event_wait();
		break;
	case OP_CONDVAR_SIGNAL: {
		void *o = obj();

		if (next_u8() & 1) {
			(void)k_condvar_broadcast(o);
		} else {
			(void)k_condvar_signal(o);
		}
		break;
	}
	case OP_CONDVAR_WAIT: {
		void *cv = obj();
		void *mutex = obj();

		(void)k_condvar_wait(cv, mutex, fz_timeout());
		break;
	}
	case OP_MUTEX: {
		void *o = obj();

		if (next_u8() & 1) {
			(void)k_mutex_unlock(o);
		} else {
			(void)k_mutex_lock(o, fz_timeout());
		}
		break;
	}
	case OP_USE:
		do_use();
		break;
	case OP_STACK_ALLOC: {
		uint8_t i = next_u8() % NUM_STACKS;
		size_t size = fz_len();

		stk[i] = k_thread_stack_alloc(size, next_u8() & K_USER);
		stk_size[i] = size;
		break;
	}
	case OP_STACK_FREE: {
		k_thread_stack_t *s = stack();

		if (!IS_ENABLED(CONFIG_SYSCALL_FUZZ_SKIP_KNOWN_BUGS) || !is_busy(s)) {
			(void)k_thread_stack_free(s);
		}
		break;
	}
	case OP_THREAD_CREATE:
		do_thread_create();
		break;
	case OP_THREAD_JOIN: {
		struct k_thread *t = obj();

		if (next_u8() & 1) {
			k_thread_abort(t);
		} else {
			(void)k_thread_join(t, fz_timeout());
		}
		break;
	}
	case OP_SLEEP:
		(void)k_sleep(fz_timeout());
		break;
	default:
		break;
	}
}
```

## src/group_poll.c
```c
/*
 * SPDX-License-Identifier: Apache-2.0
 *
 * Group "poll": k_poll() with fuzzed event arrays, plus the syscalls that
 * change the state of the polled objects.
 */

#include "harness.h"

#define MAX_EVENTS 8

/* Kernel objects the workers may legitimately use */
K_SEM_DEFINE(fz_sem, 0, 3);
K_MSGQ_DEFINE(fz_msgq, 4, 4, 4);
K_QUEUE_DEFINE(fz_queue);
K_PIPE_DEFINE(fz_pipe, 16, 4);
struct k_poll_signal fz_signal = K_POLL_SIGNAL_INITIALIZER(fz_signal);
K_APP_BMEM(fz_part) static struct k_poll_event events[MAX_EVENTS];

/*
 * Pool of object pointers for k_poll events. Includes valid objects, objects
 * of the wrong type, kernel memory that is not an object, and NULL.
 */
static void *const objs[] = {
	&fz_sem, &fz_msgq, &fz_queue, &fz_pipe, &fz_signal,
	&workers[0], &fz_heap, NULL,
};

enum fz_op {
	OP_POLL,
	OP_SEM_GIVE,
	OP_SEM_TAKE,
	OP_SIGNAL_RAISE,
	OP_SIGNAL_RESET,
	OP_MSGQ_PUT,
	OP_MSGQ_GET,
	OP_MSGQ_PURGE,
	OP_QUEUE_APPEND,
	OP_QUEUE_GET,
	OP_PIPE_WRITE,
	OP_PIPE_READ,
	OP_PIPE_RESET,
	OP_COUNT,
};

/*
 * OP_POLL encoding:
 *   u8  number of events present in the payload (mod MAX_EVENTS + 1)
 *   u8  flags: bit0 raw num_events (u32 follows)
 *              bit1 replace events pointer: bit2 ? raw u32 : kernel address
 *   n * { sizeof(struct k_poll_event) raw bytes, u8 object selector }
 *   u8  timeout in ticks (mod 3; 0 is K_NO_WAIT)
 */
static void do_poll(void)
{
	uint8_t n = next_u8() % (MAX_EVENTS + 1);
	uint8_t flags = next_u8();
	struct k_poll_event *ev = events;
	int num = n;

	for (int i = 0; i < n; i++) {
		uint8_t *raw = (uint8_t *)&events[i];
		uint8_t sel;

		for (size_t j = 0; j < sizeof(events[i]); j++) {
			raw[j] = next_u8();
		}
		/* Out-of-range selectors keep the raw pointer from the payload */
		sel = next_u8();
		if (sel < ARRAY_SIZE(objs)) {
			events[i].obj = objs[sel];
		}
	}

	if (flags & BIT(0)) {
		num = (int)next_u32();
	}
	if (flags & BIT(1)) {
		ev = (flags & BIT(2)) ? (struct k_poll_event *)fz_raw_ptr()
				      : (struct k_poll_event *)&fz_heap;
	}

	(void)k_poll(ev, num, K_TICKS(next_u8() % 3));
}

void group_setup(void)
{
	for (int i = 0; i < NUM_WORKERS; i++) {
		k_thread_access_grant(&workers[i], &fz_sem, &fz_msgq, &fz_queue, &fz_pipe,
				      &fz_signal);
	}
}

void group_op(uint8_t op)
{
switch (op % OP_COUNT) {
	case OP_POLL:
		do_poll();
		break;
	case OP_SEM_GIVE:
		k_sem_give(&fz_sem);
		break;
	case OP_SEM_TAKE:
		(void)k_sem_take(&fz_sem, K_NO_WAIT);
		break;
	case OP_SIGNAL_RAISE:
		(void)k_poll_signal_raise(&fz_signal, (int)next_u32());
		break;
	case OP_SIGNAL_RESET:
		k_poll_signal_reset(&fz_signal);
		break;
	case OP_MSGQ_PUT:
		for (int i = 0; i < 4; i++) {
			scratch[i] = next_u8();
		}
		(void)k_msgq_put(&fz_msgq, scratch, K_NO_WAIT);
		break;
	case OP_MSGQ_GET:
		(void)k_msgq_get(&fz_msgq, scratch, K_NO_WAIT);
		break;
	case OP_MSGQ_PURGE:
		k_msgq_purge(&fz_msgq);
		break;
	case OP_QUEUE_APPEND:
		(void)k_queue_alloc_append(&fz_queue, &scratch[next_u8() % 16]);
		break;
	case OP_QUEUE_GET:
		(void)k_queue_get(&fz_queue, K_NO_WAIT);
		break;
	case OP_PIPE_WRITE: {
		uint8_t len = next_u8() % 32;

		for (int i = 0; i < len; i++) {
			scratch[i] = next_u8();
		}
		(void)k_pipe_write(&fz_pipe, scratch, len, K_NO_WAIT);
		break;
	}
	case OP_PIPE_READ:
		(void)k_pipe_read(&fz_pipe, scratch, next_u8() % 32, K_NO_WAIT);
		break;
	case OP_PIPE_RESET:
		k_pipe_reset(&fz_pipe);
		break;
	default:
		break;
	}
}
```

## src/group_thread.c
```c
/*
 * SPDX-License-Identifier: Apache-2.0
 *
 * Group "thread": syscalls that read or change attributes of another thread
 * (name, priority, deadline, suspension, timeouts, stack usage). Targets come
 * from fz_thread(): the caller, the other workers, a thread that was created
 * but never started, a thread that already exited, a thread the caller has no
 * permission on, NULL and raw pointers. Workers may suspend, abort or wake
 * each other while the target is blocked in a syscall.
 */

#include "harness.h"

K_APP_BMEM(fz_part) static char name_buf[CONFIG_THREAD_MAX_NAME_LEN + 4];
K_APP_BMEM(fz_part) static size_t unused;
K_APP_BMEM(fz_part) static uint32_t result;

/* Strings for k_thread_name_set(): terminated, unterminated, unmapped, ... */
static const char *name_str(void)
{
	uint8_t sel = next_u8();

	switch (sel % 4) {
	case 0:
		/* NUL-terminated at a fuzzed position within the scratch buffer */
		scratch[next_u8() % SCRATCH_SIZE] = '\0';
		return (const char *)scratch;
	case 1:
		return "fz";
	default:
		/* scratch without terminator, partition end, kernel, NULL, raw */
		return fz_ptr();
	}
}

enum op {
	OP_NAME_SET,
	OP_NAME_COPY,
	OP_PRIORITY_SET,
	OP_PRIORITY_GET,
	OP_DEADLINE_SET,
	OP_SUSPEND,
	OP_RESUME,
	OP_WAKEUP,
	OP_JOIN,
	OP_ABORT,
	OP_TIMEOUT_GET,
	OP_STACK_SPACE,
	OP_STACK_THRESHOLD,
	OP_CUSTOM_DATA,
	OP_SLEEP,
	OP_YIELD,
	OP_COUNT,
};

void group_setup(void)
{
}

void group_op(uint8_t op)
{
	switch (op % OP_COUNT) {
	case OP_NAME_SET: {
		struct k_thread *t = fz_thread();

		result = k_thread_name_set(t, name_str());
		break;
	}
	case OP_NAME_COPY: {
		struct k_thread *t = fz_thread();
		uint8_t sel = next_u8();
		char *buf = (sel & 1) ? name_buf : fz_ptr();

		result = k_thread_name_copy(t, buf, (sel & 2) ? fz_len() : (sel >> 2) % sizeof(name_buf));
		break;
	}
	case OP_PRIORITY_SET: {
		struct k_thread *t = fz_thread();
		uint8_t sel = next_u8();
		int prio = (sel & 1) ? (int)next_u32() : (int)(sel >> 1) - 64;

		k_thread_priority_set(t, prio);
		break;
	}
	case OP_PRIORITY_GET:
		result = k_thread_priority_get(fz_thread());
		break;
	case OP_DEADLINE_SET: {
		struct k_thread *t = fz_thread();
		uint8_t sel = next_u8();
		int deadline = (sel & 2) ? (int)next_u32() : (int)(sel >> 2) - 8;

		if (sel & 1) {
			k_thread_absolute_deadline_set(t, deadline);
		} else {
			k_thread_deadline_set(t, deadline);
		}
		break;
	}
	case OP_SUSPEND:
		k_thread_suspend(fz_thread());
		break;
	case OP_RESUME:
		k_thread_resume(fz_thread());
		break;
	case OP_WAKEUP:
		/* Also starts the dormant thread (k_thread_start is not a syscall) */
		k_wakeup(fz_thread());
		break;
	case OP_JOIN: {
		struct k_thread *t = fz_thread();

		result = k_thread_join(t, fz_timeout());
		break;
	}
	case OP_ABORT:
		k_thread_abort(fz_thread());
		break;
	case OP_TIMEOUT_GET: {
		struct k_thread *t = fz_thread();

		result = (next_u8() & 1) ? k_thread_timeout_expires_ticks(t)
					 : k_thread_timeout_remaining_ticks(t);
		break;
	}
	case OP_STACK_SPACE: {
		struct k_thread *t = fz_thread();

		result = k_thread_stack_space_get(t, (next_u8() & 1) ? fz_ptr() : &unused);
		break;
	}
	case OP_STACK_THRESHOLD: {
#if defined(CONFIG_THREAD_RUNTIME_STACK_SAFETY)
		struct k_thread *t = fz_thread();
		uint8_t sel = next_u8();

		if (sel % 3 == 0) {
			result = k_thread_runtime_stack_unused_threshold_pct_set(t, next_u32());
		} else if (sel % 3 == 1) {
			result = k_thread_runtime_stack_unused_threshold_set(t, fz_len());
		} else {
			result = k_thread_runtime_stack_unused_threshold_get(t);
		}
#endif
		break;
	}
	case OP_CUSTOM_DATA:
		if (next_u8() & 1) {
			k_thread_custom_data_set((void *)(uintptr_t)next_u32());
		} else {
			result = (uintptr_t)k_thread_custom_data_get();
		}
		break;
	case OP_SLEEP:
		(void)k_sleep(fz_timeout());
		break;
	case OP_YIELD:
		k_yield();
		break;
	default:
		break;
	}
}
```

## src/harness.h
```c
/*
 * SPDX-License-Identifier: Apache-2.0
 *
 * Interface between the common harness (main.c) and the per-group syscall
 * interpreters (group_*.c). See main.c for the overall design.
 */

#ifndef SYSCALL_FUZZ_HARNESS_H
#define SYSCALL_FUZZ_HARNESS_H

#include <zephyr/kernel.h>
#include <zephyr/app_memory/app_memdomain.h>

#define AFL_INPUT_MAX 4096
#define NUM_WORKERS   CONFIG_SYSCALL_FUZZ_WORKERS
#define SCRATCH_SIZE  64

/* User-accessible partition shared by all workers */
extern struct k_mem_partition fz_part;

/* Input stream and scratch buffer, in fz_part (see main.c for the order) */
struct fz_mem {
	uint32_t upos;
	uint32_t ulen;
	uint32_t op_offset;
	uint8_t cur_op;
	uint8_t selftest_op;
	uint8_t ubuf[AFL_INPUT_MAX];
	uint8_t scratch[SCRATCH_SIZE];
};
extern struct fz_mem fz_mem;
#define scratch (fz_mem.scratch)

/* User threads interpreting the input */
extern struct k_thread workers[NUM_WORKERS];

/* Kernel heap assigned to the workers (k_queue_alloc_append, ...) */
extern struct k_heap fz_heap;

/* Input stream, consumed by all workers (zero once exhausted) */
uint8_t next_u8(void);
uint32_t next_u32(void);

/*
 * Argument pools, mixing valid values, wrong types, kernel addresses the
 * caller has no access to, NULL and raw 32-bit values from the input.
 */
void *fz_ptr(void);	    /* buffer pointer for copies in/out */
void *fz_raw_ptr(void);	    /* raw 32-bit address, never into the stream state */
size_t fz_len(void);	    /* buffer length */
k_timeout_t fz_timeout(void);
struct k_thread *fz_thread(void);

/* Entry point for extra user threads; sleeps (uintptr_t)p1 % 4 ticks */
void fz_child_entry(void *p1, void *p2, void *p3);

/* Implemented by the group */
void group_setup(void);		/* supervisor: init objects, grant access */
void group_op(uint8_t op);	/* user: run one operation */

#endif
```
